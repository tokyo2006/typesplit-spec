## config/boards/shields/typesplit/Kconfig.shield
```kconfig
# Copyright (c) 2020 The ZMK Contributors
# SPDX-License-Identifier: MIT

config SHIELD_TYPESPLIT_CENTRAL_DONGLE
    def_bool $(shields_list_contains,typesplit_central_dongle)

config SHIELD_TYPESPLIT_CENTRAL_LEFT
    def_bool $(shields_list_contains,typesplit_central_left)
    
config SHIELD_TYPESPLIT_PERIPHERAL_LEFT
    def_bool $(shields_list_contains,typesplit_peripheral_left)

config SHIELD_TYPESPLIT_PERIPHERAL_RIGHT
    def_bool $(shields_list_contains,typesplit_peripheral_right)
 
```
