/*
 * Copyright (c) 2020 ZMK Contributors
 *
 * SPDX-License-Identifier: MIT
 */

#include "typesplit.dtsi"

&kscan0 {
	row-gpios
	= <&gpio0 3 (GPIO_ACTIVE_HIGH | GPIO_PULL_DOWN)>
	, <&gpio0 29 (GPIO_ACTIVE_HIGH | GPIO_PULL_DOWN)>
	, <&gpio1 12 (GPIO_ACTIVE_HIGH | GPIO_PULL_DOWN)>
	, <&gpio1 13 (GPIO_ACTIVE_HIGH | GPIO_PULL_DOWN)>
        , <&gpio1 10 (GPIO_ACTIVE_HIGH | GPIO_PULL_DOWN)>
	;
	col-gpios
        = <&gpio0 6 GPIO_ACTIVE_HIGH>
        , <&gpio1 9 GPIO_ACTIVE_HIGH>
        , <&gpio0 23 GPIO_ACTIVE_HIGH>
        , <&gpio0 21 GPIO_ACTIVE_HIGH>
        , <&gpio0 30 GPIO_ACTIVE_HIGH>
        , <&gpio0 28 GPIO_ACTIVE_HIGH>
        , <&gpio1 14 GPIO_ACTIVE_HIGH>
        ;
};

